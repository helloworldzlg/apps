## examples/bcas_systemapp/Kconfig
```kconfig
#
# For a description of the syntax of this configuration file,
# see the file kconfig-language.txt in the NuttX tools repository.
#

config EXAMPLES_BCAS_SYSTEMAPP
	bool "\"bcas system app\" example"
	default n
	---help---
		Enable the \"bcas system app\" example

if EXAMPLES_BCAS_SYSTEMAPP

config EXAMPLES_BCAS_SYSTEMAPP_PROGNAME
	string "Program name"
	default "bcas_systemapp"
	depends on BUILD_KERNEL
	---help---
		This is the name of the program that will be use when the NSH ELF
		program is installed.

config EXAMPLES_BCAS_SYSTEMAPP_PRIORITY
	int "BCAS_SYSTEMAPP task priority"
	default 100

config EXAMPLES_BCAS_SYSTEMAPP_STACKSIZE
	int "BCAS_SYSTEMAPP stack size"
	default 4096

endif
```
